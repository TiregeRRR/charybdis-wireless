## config/west.yml
```yaml
manifest:
  defaults:
    remote: urob
    revision: v0.3

  remotes:
    - name: zmkfirmware
      url-base: https://github.com/zmkfirmware
    - name: urob
      url-base: https://github.com/urob
    - name: charlesmst
      url-base: https://github.com/charlesmst
    - name: inorichi
      url-base: https://github.com/inorichi

  projects:
    - name: zmk
      remote: zmkfirmware
      revision: v0.3
      import: app/west.yml
    - name: zmk-tri-state
    - name: zmk-pmw3610-driver
      remote: charlesmst
      revision: main

  self:
    path: config
```
